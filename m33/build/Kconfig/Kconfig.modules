## m33/build/Kconfig/Kconfig.modules
```kconfig
menu "acpica (C:/analog/cfs/1.1.0/SDK/zephyr/modules/lib/acpica)"
osource "$(ZEPHYR_ACPICA_KCONFIG)"
config ZEPHYR_ACPICA_MODULE
	bool
	default y
endmenu
menu "cmsis (C:/analog/cfs/1.1.0/SDK/zephyr/modules/hal/cmsis)"
osource "$(ZEPHYR_CMSIS_KCONFIG)"
config ZEPHYR_CMSIS_MODULE
	bool
	default y
endmenu
menu "cmsis-dsp (C:/analog/cfs/1.1.0/SDK/zephyr/modules/lib/cmsis-dsp)"
osource "$(ZEPHYR_CMSIS_DSP_KCONFIG)"
config ZEPHYR_CMSIS_DSP_MODULE
	bool
	default y
endmenu
menu "cmsis-nn (C:/analog/cfs/1.1.0/SDK/zephyr/modules/lib/cmsis-nn)"
osource "$(ZEPHYR_CMSIS_NN_KCONFIG)"
config ZEPHYR_CMSIS_NN_MODULE
	bool
	default y
endmenu
menu "fatfs (C:/analog/cfs/1.1.0/SDK/zephyr/modules/fs/fatfs)"
osource "$(ZEPHYR_FATFS_KCONFIG)"
config ZEPHYR_FATFS_MODULE
	bool
	default y
endmenu
config ZEPHYR_ADI_MODULE
	bool
	default y
menu "hostap (C:/analog/cfs/1.1.0/SDK/zephyr/modules/lib/hostap)"
osource "$(ZEPHYR_HOSTAP_KCONFIG)"
config ZEPHYR_HOSTAP_MODULE
	bool
	default y
endmenu
menu "liblc3 (C:/analog/cfs/1.1.0/SDK/zephyr/modules/lib/liblc3)"
osource "$(ZEPHYR_LIBLC3_KCONFIG)"
config ZEPHYR_LIBLC3_MODULE
	bool
	default y
endmenu
config ZEPHYR_LIBMCTP_MODULE
	bool
	default y
config ZEPHYR_LIBMETAL_MODULE
	bool
	default y
menu "littlefs (C:/analog/cfs/1.1.0/SDK/zephyr/modules/fs/littlefs)"
osource "$(ZEPHYR_LITTLEFS_KCONFIG)"
config ZEPHYR_LITTLEFS_MODULE
	bool
	default y
endmenu
menu "loramac-node (C:/analog/cfs/1.1.0/SDK/zephyr/modules/lib/loramac-node)"
osource "$(ZEPHYR_LORAMAC_NODE_KCONFIG)"
config ZEPHYR_LORAMAC_NODE_MODULE
	bool
	default y
endmenu
menu "lvgl (C:/analog/cfs/1.1.0/SDK/zephyr/modules/lib/gui/lvgl)"
osource "C:/analog/cfs/1.1.0/SDK/zephyr/modules/lib/gui/lvgl/zephyr/Kconfig"
config ZEPHYR_LVGL_MODULE
	bool
	default y
endmenu
menu "mbedtls (C:/analog/cfs/1.1.0/SDK/zephyr/modules/crypto/mbedtls)"
osource "$(ZEPHYR_MBEDTLS_KCONFIG)"
config ZEPHYR_MBEDTLS_MODULE
	bool
	default y
endmenu
config ZEPHYR_MCUBOOT_MODULE
	bool
	default y
config ZEPHYR_MIPI_SYS_T_MODULE
	bool
	default y
menu "nrf_wifi (C:/analog/cfs/1.1.0/SDK/zephyr/modules/lib/nrf_wifi)"
osource "$(ZEPHYR_NRF_WIFI_KCONFIG)"
config ZEPHYR_NRF_WIFI_MODULE
	bool
	default y

config ZEPHYR_NRF_WIFI_MODULE_BLOBS
	bool
endmenu
config ZEPHYR_OPEN_AMP_MODULE
	bool
	default y
menu "openthread (C:/analog/cfs/1.1.0/SDK/zephyr/modules/lib/openthread)"
osource "$(ZEPHYR_OPENTHREAD_KCONFIG)"
config ZEPHYR_OPENTHREAD_MODULE
	bool
	default y
endmenu
config ZEPHYR_PACKETCRAFT_ADI_MODULE
	bool
	default y
	select TAINT_BLOBS

config ZEPHYR_PACKETCRAFT_ADI_MODULE_BLOBS
	bool
	default y
menu "percepio (C:/analog/cfs/1.1.0/SDK/zephyr/modules/debug/percepio)"
osource "C:/analog/cfs/1.1.0/SDK/zephyr/modules/debug/percepio/zephyr/Kconfig"
config ZEPHYR_PERCEPIO_MODULE
	bool
	default y
endmenu
menu "picolibc (C:/analog/cfs/1.1.0/SDK/zephyr/modules/lib/picolibc)"
osource "C:/analog/cfs/1.1.0/SDK/zephyr/modules/lib/picolibc/zephyr/Kconfig"
config ZEPHYR_PICOLIBC_MODULE
	bool
	default y
endmenu
menu "segger (C:/analog/cfs/1.1.0/SDK/zephyr/modules/debug/segger)"
osource "$(ZEPHYR_SEGGER_KCONFIG)"
config ZEPHYR_SEGGER_MODULE
	bool
	default y
endmenu
config ZEPHYR_TF_M_TESTS_MODULE
	bool
	default y
config ZEPHYR_TINYCRYPT_MODULE
	bool
	default y
menu "trusted-firmware-a (C:/analog/cfs/1.1.0/SDK/zephyr/modules/tee/tf-a/trusted-firmware-a)"
osource "$(ZEPHYR_TRUSTED_FIRMWARE_A_KCONFIG)"
config ZEPHYR_TRUSTED_FIRMWARE_A_MODULE
	bool
	default y
endmenu
menu "trusted-firmware-m (C:/analog/cfs/1.1.0/SDK/zephyr/modules/tee/tf-m/trusted-firmware-m)"
osource "$(ZEPHYR_TRUSTED_FIRMWARE_M_KCONFIG)"
config ZEPHYR_TRUSTED_FIRMWARE_M_MODULE
	bool
	default y
endmenu
menu "uoscore-uedhoc (C:/analog/cfs/1.1.0/SDK/zephyr/modules/lib/uoscore-uedhoc)"
osource "$(ZEPHYR_UOSCORE_UEDHOC_KCONFIG)"
config ZEPHYR_UOSCORE_UEDHOC_MODULE
	bool
	default y
endmenu
menu "zcbor (C:/analog/cfs/1.1.0/SDK/zephyr/modules/lib/zcbor)"
osource "$(ZEPHYR_ZCBOR_KCONFIG)"
config ZEPHYR_ZCBOR_MODULE
	bool
	default y
endmenu
```

## m33/build/Kconfig/arch/Kconfig
```kconfig
# Load Zephyr Arch Kconfig descriptions.
osource "C:/analog/cfs/1.1.0/SDK/zephyr/zephyr/arch/x86/Kconfig"
osource "C:/analog/cfs/1.1.0/SDK/zephyr/zephyr/arch/xtensa/Kconfig"
osource "C:/analog/cfs/1.1.0/SDK/zephyr/zephyr/arch/sparc/Kconfig"
osource "C:/analog/cfs/1.1.0/SDK/zephyr/zephyr/arch/riscv/Kconfig"
osource "C:/analog/cfs/1.1.0/SDK/zephyr/zephyr/arch/posix/Kconfig"
osource "C:/analog/cfs/1.1.0/SDK/zephyr/zephyr/arch/nios2/Kconfig"
osource "C:/analog/cfs/1.1.0/SDK/zephyr/zephyr/arch/mips/Kconfig"
osource "C:/analog/cfs/1.1.0/SDK/zephyr/zephyr/arch/arm64/Kconfig"
osource "C:/analog/cfs/1.1.0/SDK/zephyr/zephyr/arch/arm/Kconfig"
osource "C:/analog/cfs/1.1.0/SDK/zephyr/zephyr/arch/arc/Kconfig"
```

## m33/build/Kconfig/boards/Kconfig
```kconfig
# Load Zephyr board Kconfig descriptions.
osource "C:/analog/cfs/1.1.0/SDK/zephyr/zephyr/boards/adi/max32657evkit/Kconfig"
```

## m33/build/Kconfig/boards/Kconfig.max32657evkit
```kconfig
# Load board Kconfig descriptions.
osource "C:/analog/cfs/1.1.0/SDK/zephyr/zephyr/boards/adi/max32657evkit/Kconfig.max32657evkit"
```
